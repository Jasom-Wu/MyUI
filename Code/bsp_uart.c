#include "main.h"

void Uart_isr() interrupt 4	 //中断接收程序
{
	if(RI)			   //判断是否接收完，接收完成后，由硬件置RI位
	{
		//Txd_data=SBUF;	       //读入缓冲区
		//=0;			   /RI/清标志
		//Recdat=1;		//有数据，建立标志
	}
}

/*
*********************************************************************************************************
*	函 数 名: bsp_SendUart
*	功能说明: 通过串口发送一个字节，等待发送完毕后才返回。
*	形    参：_data ： 待发送的数据
*	返 回 值: 无
*********************************************************************************************************
*/
void UART_SendByte(uint8_t _data)
{
	SBUF = _data;	/* 发送数据送缓冲 */
	while(!TI);		/* 等待发送完成 */
	TI = 0;
}

/*
*********************************************************************************************************
*	函 数 名: UART_GetByte
*	功能说明: 等待串口接收一个字节
*	形    参：_data ： 待发送的数据
*	返 回 值: 无
*********************************************************************************************************
*/
uint8_t UART_GetByte(void)
{
	uint8_t c;

	while (RI == 0);
	c = SBUF;
	RI = 0;	

	return c;
}

/*
*********************************************************************************************************
*	函 数 名: UART_SendBuf
*	功能说明: 通过串口发送一个字节，等待发送完毕后才返回。
*	形    参：_pBuf : 待发送的数据缓冲区
*			  _len : 数据长度
*	返 回 值: 无
*********************************************************************************************************
*/
void UART_SendBuf(uint8_t *_pBuf, uint8_t _len)
{
	while(_len--)
	{
		UART_SendByte(*_pBuf++);
	}
}

/*
*********************************************************************************************************
*	函 数 名: bsp_InitUart
*	功能说明: 初始化CPU的U串口硬件设备。未启用中断。
*	形    参：无
*	返 回 值: 无
*********************************************************************************************************
*/
void bsp_InitUart(void)
{
	PCON |= 0x80;		/* SMOD置1,双倍速率 */
	SCON = 0x50;		/* 010 1 0000B，工作方式1, 8位UART，波特率可变，允许接收 */
	TMOD &= 0x0F;		//设置定时器模式
	TMOD |= 0x20;		/* T1工作于方式2 */
	TL1 = 0xFA;			//设置定时初始值
	TH1 = 0xFA;			//设置定时重载值
	ET1 = 0;			//禁止定时器中断
	TR1 = 1;			//定时器1开始计时
	RI = 0;
	TI = 0;
}

/*
*********************************************************************************************************
*	函 数 名: putchar
*	功能说明: 重定义 putchar 函数， 这样可以使用printf函数从串口1打印输出
*	形    参: 等待发送的字符
*	返 回 值: 返回已发送的字符
*********************************************************************************************************
*/
char putchar(char c)
{
	/* 发送一个字符 c 到UART1 */
	UART_SendByte(c);

	return (c);
}

/*
*********************************************************************************************************
*	函 数 名: getchar
*	功能说明: 重定义C库中的 getchar 函数,这样可以使用scanff函数从串口1输入数据
*	形    参: 无
*	返 回 值: 返回已读到的字符
*********************************************************************************************************
*/
char getchar(void)
{
	return UART_GetByte();
}